## conf/layer.conf
```bitbake
#
# Copyright (C) 2019 Wind River Systems, Inc.
#

# We have a conf and classes directory, add to BBPATH
BBPATH =. "${LAYERDIR}:"

LAYERRECOMMENDS_sage-zynqmp  = "xilinx-zynqmp-dl"

# We have a packages directory, add to BBFILES
BBFILES += "${LAYERDIR}/recipes-*/*/*.bb \
	${LAYERDIR}/recipes-*/*/*.bbappend"


HDF_MACHINE:sage-zynqmp ?= "zcu102-zynqmp"
BBFILE_COLLECTIONS += "sage-zynqmp"
BBFILE_PATTERN_sage-zynqmp := "^${LAYERDIR}/"
BBFILE_PRIORITY_sage-zynqmp = "7"

# Expand the allow list
WRL_RECIPES:xilinx += " \
    u-boot-xlnx \
"

# This should only be incremented on significant changes that will
# cause compatibility issues with other layers
LAYERVERSION_sage-zynqmp = "1"

LAYERDEPENDS_sage-zynqmp = "core wrlinux xilinx-tools xilinx"
LAYERSERIES_COMPAT_sage-zynqmp = "wrl kirkstone"

LAYER_PATH_sage-zynqmp = "${LAYERDIR}"

# We have a pre-populated downloads directory, add to PREMIRRORS
PREMIRRORS:append = " \
     .*://.*/.* file://${LAYERDIR}/downloads/ \n \
     git://.*/.* git://${LAYERDIR}/git/MIRRORNAME;protocol=file \n \
"
```

## conf/machine/sage-zynqmp.conf
```bitbake
#@TYPE: Machine
#@NAME: sage-zynqmp
#@DESCRIPTION: Machine configuration for Zynq Ultrascale+ MPSoC plus sage drivers

require sage-zynqmp.inc
EXTRA_IMAGECMD:jffs2 = "--pad --no-cleanmarkers --eraseblock=128"
KMACHINE:sage-zynqmp = "xilinx-zynqmp"
```
